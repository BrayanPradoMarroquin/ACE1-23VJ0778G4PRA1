#include "LedControl.h"

#define DIN 7
#define CLK 6
#define LOAD 5

LedControl matriz = LedControl(DIN, CLK, LOAD, 1);

void setup() {
  matriz.shutdown(0, false);
  matriz.setIntensity(0, 8);
  for (int i = 14; i <= 21; i++)
    pinMode(i, OUTPUT);
  for (int i = 22; i <= 29; i++)
    pinMode(i, OUTPUT);
  for (int i = 14; i <= 21; i++)
    digitalWrite(i, HIGH);
  for (int i = 22; i <= 29; i++)
    digitalWrite(i, LOW);
}

void pintarLED(int x, int y) {
  digitalWrite(14 + y, LOW);
  digitalWrite(22 + x, HIGH);
  delayMicroseconds(1100);
  digitalWrite(14 + y, HIGH);
  digitalWrite(22 + x, LOW);
}


byte buffer[8][16] = { { 0, 0, 0, 0, 0, 0, 0, 0, 0, 0, 0, 0, 0, 0, 0, 0 },
                       { 0, 1, 0, 0, 1, 0, 0, 0, 0, 0, 0, 1, 0, 0, 1, 0 },
                       { 0, 0, 0, 0, 0, 0, 0, 0, 0, 0, 0, 0, 0, 0, 0, 0 },
                       { 0, 1, 0, 0, 1, 0, 0, 0, 0, 0, 0, 1, 1, 1, 1, 0 },
                       { 0, 0, 1, 1, 0, 0, 0, 0, 0, 0, 0, 0, 0, 0, 0, 0 },
                       { 0, 0, 0, 0, 0, 0, 0, 0, 0, 0, 0, 0, 0, 0, 0, 0 },
                       { 0, 0, 0, 0, 0, 0, 0, 0, 0, 0, 0, 0, 0, 0, 0, 0 },
                       { 0, 0, 0, 0, 0, 0, 0, 0, 0, 0, 0, 0, 0, 0, 0, 0 } };

byte MatrizFrase[8][110] = {

  { 0, 0, 0, 0, 0, 0, 0, 0, 0, 0, 0, 0, 0,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 0, 0 },
  { 0, 0, 0, 0, 0, 0, 0, 0, 0, 0, 0, 0, 0,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 0, 0 },
  { 0, 0, 0, 0, 0, 0, 0, 0, 0, 0, 1, 1, 1,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 0, 0 },
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  { 0, 0, 0, 0, 0, 0, 0, 0, 0, 0, 1, 0, 0,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 0, 0 }
};

int aumentar = -4;
void setMatriz() {
  for (int i = 0; i < 8; i++)
    for (int j = 0; j < 16; j++) {
      if (MatrizFrase[i][(j + aumentar) % 110] == 1)
        buffer[i][j] = 1;
      else
        buffer[i][j] = 0;
    }
  if (aumentar >= 100) {
    for (int i = 0; i < 8; i++) {
      for (int j = 0; j < 110; j++)
        buffer[i][j] = 0;
    }
    aumentar = -4;
  }
  if (aumentar <= -5) {
    for (int i = 0; i < 8; i++) {
      for (int j = 0; j < 110; j++)
        buffer[i][j] = 0;
    }
    aumentar = 100;
  }
}

void mostrarMatriz() {
  // Con driver
  for (int i = 0; i < 8; i++)
    for (int j = 0; j < 8; j++)
      matriz.setLed(0, i, j, buffer[i][j] == 1 ? true : false);
  // Sin driver
  for (int k = 0; k < 3; k++)
    for (int i = 0; i < 8; i++)
      for (int j = 8; j < 16; j++)
        if (buffer[i][j] == 1)
          pintarLED(j - 8, i);
        else
          delayMicroseconds(50);
}
const unsigned long debounceDelay = 50;
int buttonState = LOW;
int lastButtonState = LOW;
unsigned long lastDebounceTime = 0;
int direccion = 1;
long int t0 = 0;
long int t1 = 0;
void loop() {
  int reading = digitalRead(13);
  t1 = millis();
  if ((t1 - t0) >= 150) {
    t0 = millis();
    aumentar = aumentar + direccion;
  }

  if (reading != lastButtonState) {
    lastDebounceTime = millis();
  }
  if ((millis() - lastDebounceTime) > debounceDelay) {
    if (reading != buttonState) {
      buttonState = reading;
      if (buttonState == HIGH) {
        if (direccion == 1) {
          direccion = -1;
        } else {
          direccion = 1;
        };
      }
    }
  }
  lastButtonState = reading;
  setMatriz();
  delay(2);
  mostrarMatriz();
  delay(1);
}
